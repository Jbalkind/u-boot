## board/openpiton/ariane/Kconfig
```kconfig
if TARGET_OPENPITON_ARIANE

config SYS_BOARD
	default "openpiton-ariane"

config SYS_VENDOR
	default "openpiton"

config SYS_CPU
	default "generic"

config SYS_CONFIG_NAME
	default "openpiton-ariane"

config SYS_TEXT_BASE
	default 0x81200000 if SPL
	default 0x80000000 if !RISCV_SMODE
	default 0x80200000 if RISCV_SMODE && ARCH_RV64I
	default 0x80400000 if RISCV_SMODE && ARCH_RV32I

config SPL_TEXT_BASE
	default 0xfff1010000

config SPL_OPENSBI_LOAD_ADDR
	hex
	default 0x81000000

config BOARD_SPECIFIC_OPTIONS # dummy
	def_bool y
	select GENERIC_RISCV
	select SUPPORT_SPL
	imply SYS_NS16550
	imply CMD_FS_GENERIC
	imply EFI_PARTITION
	imply CMD_EXT4
	imply BOARD_LATE_INIT
	imply SMP
	imply SPL_RAM_SUPPORT
	imply SPL_RAM_DEVICE

endif
```
